## sdkconfig.defaults
```kconfig
CONFIG_ARDUINO_UDP_TASK_PRIORITY=5

CONFIG_ESP32_WIFI_DYNAMIC_RX_BUFFER_NUM=64

CONFIG_LWIP_TCPIP_TASK_PRIO=5

CONFIG_LWIP_TCPIP_TASK_STACK_SIZE=8192

CONFIG_FREERTOS_HZ=1000

CONFIG_AUTOSTART_ARDUINO=y
```
